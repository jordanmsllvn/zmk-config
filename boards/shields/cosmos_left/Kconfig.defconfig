## boards/shields/cosmos_left/Kconfig.defconfig
```kconfig
if SHIELD_MY_DACTYL_LEFT
    # Assign the human-readable name advertised over USB/BLE
    config ZMK_KEYBOARD_NAME
        default "Cosmos"

    # Mark this half as the central side of the split
    config ZMK_SPLIT_ROLE_CENTRAL
        default y
endif

if SHIELD_MY_DACTYL_LEFT || SHIELD_MY_DACTYL_RIGHT
    # Enable split support on both halves
    config ZMK_SPLIT
        default y
endif
```

## boards/shields/cosmos_right/Kconfig.defconfig
```kconfig
if SHIELD_MY_DACTYL_RIGHT
    # Peripheral halves typically don’t set a name; omit ZMK_KEYBOARD_NAME
endif

if SHIELD_MY_DACTYL_LEFT || SHIELD_MY_DACTYL_RIGHT
    # Enable split support on both halves
    config ZMK_SPLIT
        default y
endif
```

## config/west.yml
```yaml
manifest:
  remotes:
    - name: zmkfirmware
      url-base: https://github.com/zmkfirmware
    - name: jordanmsllvn
      url-base: https://github.com/jordanmsllvn
    # Additional modules containing boards/shields/custom code can be listed here as well
    # See https://docs.zephyrproject.org/3.2.0/develop/west/manifest.html#projects
  projects:
    - name: zmk
      remote: zmkfirmware
      revision: main
      import: app/west.yml
    - name: zmk-cosmos-module
      remote: jordanmsllvn
      revision: main
  self:
    path: config
```
